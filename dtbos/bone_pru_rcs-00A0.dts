/dts-v1/;
/plugin/;

/ {
    compatible = "ti,beaglebone", "ti,beaglebone-black";

    /* identification */
    part-number = "rc_switch_pru";

    fragment@0 {
        target = <&am33xx_pinmux>;
        __overlay__ {
            pru01_pins: pru01_pins {
                pinctrl-single,pins = <
					0x03C 0x26  /* P8_15 to PRU input */
					0x038 0x26  /* P8_16 to PRU input */
					0x084 0x26  /* P8_27 to PRU input */
                    0x080 0x26  /* P8_28 to PRU input */
					0x0E8 0x26  /* P8_29 to PRU input */
					0x0E0 0x26  /* P8_30 to PRU input */
                    0x0E4 0x26  /* P8_39 to PRU input */
					0x0EC 0x26  /* P8_40 to PRU input */
                    0x0B8 0x26  /* P8_41 to PRU input */
					0x0BC 0x26  /* P8_42 to PRU input */
					0x0B0 0x26  /* P8_43 to PRU input */
					0x0B4 0x26  /* P8_44 to PRU input */
					0x0A8 0x26  /* P8_45 to PRU input */
					0x0AC 0x26  /* P8_46 to PRU input */
					0x0A0 0x26  /* P8_47 to PRU input */
					0x0A4 0x26  /* P8_48 to PRU input */
					0x030 0x06  /* P8_12 to PRU output */
					0x034 0x06  /* P8_11 to PRU output */
					0x190 0x05  /* P9_31 to PRU output */
                    0x194 0x05  /* P9_29 to PRU output */
					0x198 0x05  /* P9_30 to PRU output */
					0x19C 0x05  /* P9_28 to PRU output */
                    0x1A0 0x05  /* P9_42 to PRU output */
					0x1A4 0x05  /* P9_27 to PRU output */
                    0x1A8 0x05  /* P9_41 to PRU output */
					0x1AC 0x05  /* P9_25 to PRU output */
					0x1B4 0x20  /* CLKOUT2 to input as per datasheet (to enable P9_41) */
					0x164 0x20  /* GPIO0_7 to input as per datasheet (to enable P9_42) */
                >;
            };
        };
    };

    fragment@1 {
        target = <&pruss>;
        __overlay__ {
			status = "okay";
			pinctrl-names = "default";
			pinctrl-0 = <&pru01_pins>;
		};
	};
};

